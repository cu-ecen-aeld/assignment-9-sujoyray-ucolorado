## base_external/Config.in
```kconfig
source "$BR2_EXTERNAL_project_base_PATH/package/aesd-assignments/Config.in"
source "$BR2_EXTERNAL_project_base_PATH/package/ldd-assignments/Config.in"
source "$BR2_EXTERNAL_project_base_PATH/package/aesdchar-assignments/Config.in"
```

## base_external/package/aesdchar-assignments/Config.in
```kconfig
config BR2_PACKAGE_AESDCHAR_ASSIGNMENTS
	bool "aesdchar-assignments"
	depends on BR2_LINUX_KERNEL
	help
	  Includes the aesdchar driver folder.
```

## base_external/package/ldd-assignments/Config.in
```kconfig
config BR2_PACKAGE_LDD_ASSIGNMENTS
	bool "ldd-assignments"
	depends on BR2_LINUX_KERNEL
	help
	  Includes the ldd driver folder.
```
